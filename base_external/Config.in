## base_external/Config.in
```kconfig
source "$BR2_EXTERNAL_aesd_assignments_PATH/package/aesd-assignments/Config.in"
source "$BR2_EXTERNAL_aesd_assignments_PATH/package/aesdchar/Config.in"
source "$BR2_EXTERNAL_aesd_assignments_PATH/package/ldd/Config.in"
```

## base_external/package/aesdchar/Config.in
```kconfig
config BR2_PACKAGE_AESDCHAR
	bool "AESDCHAR"
	help
	  Includes Linux AESD Char Device Driver.
```

## base_external/package/ldd/Config.in
```kconfig
config BR2_PACKAGE_LDD
	bool "LDD"
	help
	  Includes Linux Device Driver examples.
```
